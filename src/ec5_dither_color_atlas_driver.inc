// Included only by epd_driver.cpp when
// MF1750_ENABLE_DITHER_COLOR_ATLAS=1. This fixture renders a fixed spatial
// mixture of already verified native factory-OTP colours. It exposes no raw
// frame, caller-selected colour, LUT, voltage, waveform, SPI-frequency,
// phase, timing, retry, recovery, or automatic chaining path.

static_assert(EPD_WIDTH == 1024 && EPD_HEIGHT == 600 &&
                  EPD_FRAME_BYTES == 307200 &&
                  EPD_CONTROLLER_WIDTH == 512 &&
                  EPD_CONTROLLER_FRAME_BYTES == 153600,
              "dither color atlas requires frozen 1024x600 packed 4bpp");
static_assert(EPD_CS1_SOURCE_HALF == 0 && !EPD_CS1_FLIP_X &&
                  !EPD_CS1_FLIP_Y && !EPD_CS1_NIBBLE_SWAP &&
                  EPD_CS2_SOURCE_HALF == 1 && !EPD_CS2_FLIP_X &&
                  !EPD_CS2_FLIP_Y && !EPD_CS2_NIBBLE_SWAP,
              "dither color atlas identities require MAP_ORIENT_V1");

namespace {

static constexpr uint8_t DCA_ROLE_COUNT = 2;
static constexpr uint8_t DCA_CODE_COUNT = 8;
static constexpr uint8_t DCA_CONTROLLER_COUNT = 2;
static constexpr uint8_t DCA_GRID_ROWS = 7;
static constexpr uint8_t DCA_GRID_COLUMNS = 5;
static constexpr uint16_t DCA_GRID_X0_LOCAL = 26;
static constexpr uint16_t DCA_GRID_Y0 = 34;
static constexpr uint16_t DCA_CELL_WIDTH = 84;
static constexpr uint16_t DCA_CELL_HEIGHT = 68;
static constexpr uint16_t DCA_COLUMN_GAP = 10;
static constexpr uint16_t DCA_ROW_GAP = 10;
static constexpr uint8_t DCA_BACKGROUND_CODE = 1;

// Rows: red+yellow, yellow+white, green+yellow, red+blue,
// red+green, green+blue, red+white. Appearance names remain hypotheses in
// the host manifest and are deliberately not encoded as physical claims.
static constexpr uint8_t DCA_FAMILY_CODES[DCA_GRID_ROWS][2] = {
    {3, 2}, {2, 1}, {6, 2}, {3, 5}, {3, 6}, {6, 5}, {3, 1},
};
static constexpr uint8_t DCA_A_QUARTERS[DCA_GRID_COLUMNS] = {4, 3, 2, 1, 0};
static constexpr uint8_t DCA_BAYER_2X2[2][2] = {{0, 2}, {3, 1}};

static_assert((DCA_GRID_X0_LOCAL & 1U) == 0 &&
                  (DCA_GRID_Y0 & 1U) == 0 &&
                  (DCA_CELL_WIDTH & 3U) == 0 &&
                  (DCA_CELL_HEIGHT & 3U) == 0 &&
                  (DCA_COLUMN_GAP & 1U) == 0 &&
                  (DCA_ROW_GAP & 1U) == 0,
              "dither patches must be byte aligned and contain whole tiles");
static_assert(DCA_GRID_X0_LOCAL + DCA_GRID_COLUMNS * DCA_CELL_WIDTH +
                      (DCA_GRID_COLUMNS - 1) * DCA_COLUMN_GAP ==
                  486U &&
                  486U <= EPD_CONTROLLER_WIDTH,
              "dither atlas grid exceeds a controller half");
static_assert(DCA_GRID_Y0 + DCA_GRID_ROWS * DCA_CELL_HEIGHT +
                      (DCA_GRID_ROWS - 1) * DCA_ROW_GAP ==
                  570U &&
                  570U <= EPD_HEIGHT,
              "dither atlas grid exceeds panel height");
static_assert(DCA_FAMILY_CODES[0][0] == 3 &&
                  DCA_FAMILY_CODES[0][1] == 2 &&
                  DCA_FAMILY_CODES[1][0] == 2 &&
                  DCA_FAMILY_CODES[1][1] == 1 &&
                  DCA_FAMILY_CODES[2][0] == 6 &&
                  DCA_FAMILY_CODES[2][1] == 2 &&
                  DCA_FAMILY_CODES[3][0] == 3 &&
                  DCA_FAMILY_CODES[3][1] == 5 &&
                  DCA_FAMILY_CODES[4][0] == 3 &&
                  DCA_FAMILY_CODES[4][1] == 6 &&
                  DCA_FAMILY_CODES[5][0] == 6 &&
                  DCA_FAMILY_CODES[5][1] == 5 &&
                  DCA_FAMILY_CODES[6][0] == 3 &&
                  DCA_FAMILY_CODES[6][1] == 1,
              "dither atlas native-colour family order changed");
static_assert(DCA_A_QUARTERS[0] == 4 && DCA_A_QUARTERS[1] == 3 &&
                  DCA_A_QUARTERS[2] == 2 && DCA_A_QUARTERS[3] == 1 &&
                  DCA_A_QUARTERS[4] == 0,
              "dither atlas mixture order changed");
static_assert(DCA_BAYER_2X2[0][0] == 0 &&
                  DCA_BAYER_2X2[0][1] == 2 &&
                  DCA_BAYER_2X2[1][0] == 3 &&
                  DCA_BAYER_2X2[1][1] == 1,
              "dither atlas ordered mask changed");

// Exact identities independently regenerated by host/dither_color_atlas.py.
// Keeping distinct CS symbols makes both controller contracts explicit even
// though MAP_ORIENT_V1 and the duplicated halves produce equal bytes.
static constexpr char DCA_ATLAS_FRAME_SHA256[] =
    "3b65803a558e91ad2112a75b158a1b696666c015829ce9fd0bce401ba96a44b7";
static constexpr char DCA_ATLAS_CS1_DTM_SHA256[] =
    "d461f7d2473afc86410181484ef31d4f4899e1de06f518cefa15506512e6f8d1";
static constexpr char DCA_ATLAS_CS2_DTM_SHA256[] =
    "d461f7d2473afc86410181484ef31d4f4899e1de06f518cefa15506512e6f8d1";
static constexpr char DCA_WHITE_FRAME_SHA256[] =
    "91f1ed45bf609a23fbdcfd037027c2e271484f58321a4707e889d11859d8453d";
static constexpr char DCA_WHITE_DTM_SHA256[] =
    "8b8fe04d4d48ab9d1abb4a858f68544164d1a091998664eef06869c098a78158";

static_assert(sizeof(DCA_ATLAS_FRAME_SHA256) == 65 &&
                  sizeof(DCA_ATLAS_CS1_DTM_SHA256) == 65 &&
                  sizeof(DCA_ATLAS_CS2_DTM_SHA256) == 65 &&
                  sizeof(DCA_WHITE_FRAME_SHA256) == 65 &&
                  sizeof(DCA_WHITE_DTM_SHA256) == 65,
              "dither atlas SHA-256 identity length changed");

static constexpr const char *DCA_FAILURE_NONE = "none";
static constexpr const char *DCA_FAILURE_ALLOCATION = "allocation";
static constexpr const char *DCA_FAILURE_LAYOUT_DESIGN = "layout_design";
static constexpr const char *DCA_FAILURE_FRAME_BUILD = "frame_build";
static constexpr const char *DCA_FAILURE_HISTOGRAM = "histogram";
static constexpr const char *DCA_FAILURE_FULL_SHA = "full_sha";
static constexpr const char *DCA_FAILURE_CS1_COMPUTE = "cs1_compute";
static constexpr const char *DCA_FAILURE_CS2_COMPUTE = "cs2_compute";
static constexpr const char *DCA_FAILURE_CS1_IDENTITY = "cs1_identity";
static constexpr const char *DCA_FAILURE_CS2_IDENTITY = "cs2_identity";
static constexpr const char *DCA_FAILURE_CASCADE_PREPARE =
    "cascade_prepare";
static constexpr const char *DCA_FAILURE_STREAM_IDENTITY =
    "stream_identity";
static constexpr const char *DCA_FAILURE_REFRESH_SEQUENCE =
    "refresh_sequence";

struct DcaRoleIdentity {
  uint32_t frameFnv1a;
  uint32_t cs1DtmFnv1a;
  uint32_t cs2DtmFnv1a;
  const char *frameSha256;
  const char *cs1DtmSha256;
  const char *cs2DtmSha256;
  uint32_t histogram[DCA_CODE_COUNT];
};

static constexpr DcaRoleIdentity DCA_IDENTITIES[DCA_ROLE_COUNT] = {
    {0xE9ACC5C5UL,
     0xAF615B0DUL,
     0xAF615B0DUL,
     DCA_ATLAS_FRAME_SHA256,
     DCA_ATLAS_CS1_DTM_SHA256,
     DCA_ATLAS_CS2_DTM_SHA256,
     {0, 271680, 85680, 114240, 0, 57120, 85680, 0}},
    {0x13340DC5UL,
     0xB7A855C5UL,
     0xB7A855C5UL,
     DCA_WHITE_FRAME_SHA256,
     DCA_WHITE_DTM_SHA256,
     DCA_WHITE_DTM_SHA256,
     {0, 614400, 0, 0, 0, 0, 0, 0}},
};

struct DcaDtmIdentity {
  uint32_t fnv1a = 0;
  uint8_t sha256[32] = {};
};

struct DcaValidation {
  const char *failureStage = DCA_FAILURE_NONE;
  int32_t failureCode = 0;
  uint32_t frameFnv1a = 0;
  DcaDtmIdentity cs1;
  DcaDtmIdentity cs2;
};

size_t dcaRoleIndex(EpdDitherColorAtlasRole role) {
  return static_cast<size_t>(role);
}

bool dcaRoleValid(EpdDitherColorAtlasRole role) {
  return dcaRoleIndex(role) < DCA_ROLE_COUNT;
}

bool dcaCodeLegal(uint8_t code) {
  return code == 0 || code == 1 || code == 2 || code == 3 || code == 5 ||
         code == 6;
}

bool dcaValidateLayoutDesign() {
  bool ranks[4] = {};
  for (uint8_t y = 0; y < 2; ++y) {
    for (uint8_t x = 0; x < 2; ++x) {
      const uint8_t rank = DCA_BAYER_2X2[y][x];
      if (rank >= 4 || ranks[rank]) return false;
      ranks[rank] = true;
    }
  }
  for (uint8_t row = 0; row < DCA_GRID_ROWS; ++row) {
    const uint8_t codeA = DCA_FAMILY_CODES[row][0];
    const uint8_t codeB = DCA_FAMILY_CODES[row][1];
    if (!dcaCodeLegal(codeA) || !dcaCodeLegal(codeB) || codeA == codeB) {
      return false;
    }
  }
  for (uint8_t column = 0; column < DCA_GRID_COLUMNS; ++column) {
    if (DCA_A_QUARTERS[column] != 4U - column) return false;
  }
  return true;
}

uint8_t dcaPatchCode(uint8_t row, uint8_t column, uint16_t localX,
                     uint16_t localY) {
  const uint8_t codeA = DCA_FAMILY_CODES[row][0];
  const uint8_t codeB = DCA_FAMILY_CODES[row][1];
  const uint8_t aQuarters = DCA_A_QUARTERS[column];
  if (aQuarters == 4) return codeA;
  if (aQuarters == 0) return codeB;
  return DCA_BAYER_2X2[localY & 1U][localX & 1U] < aQuarters ? codeA
                                                             : codeB;
}

void dcaFillPatch(uint8_t *frame, uint16_t x0, uint16_t y0, uint8_t row,
                  uint8_t column) {
  static constexpr size_t kFullRowBytes = EPD_WIDTH / 2;
  for (uint16_t localY = 0; localY < DCA_CELL_HEIGHT; ++localY) {
    uint8_t *target = frame +
                      static_cast<size_t>(y0 + localY) * kFullRowBytes +
                      x0 / 2;
    for (uint16_t localX = 0; localX < DCA_CELL_WIDTH; localX += 2) {
      const uint8_t high = dcaPatchCode(row, column, localX, localY);
      const uint8_t low = dcaPatchCode(row, column, localX + 1, localY);
      *target++ = static_cast<uint8_t>((high << 4) | low);
    }
  }
}

bool dcaBuildFrame(EpdDitherColorAtlasRole role, uint8_t *frame,
                   uint32_t *histogram) {
  if (!frame || !histogram || !dcaRoleValid(role) ||
      !dcaValidateLayoutDesign()) {
    return false;
  }
  std::memset(frame,
              static_cast<uint8_t>((DCA_BACKGROUND_CODE << 4) |
                                   DCA_BACKGROUND_CODE),
              EPD_FRAME_BYTES);
  if (role == EpdDitherColorAtlasRole::Atlas) {
    for (uint8_t controller = 0; controller < DCA_CONTROLLER_COUNT;
         ++controller) {
      const uint16_t halfOffset =
          controller == 0 ? 0 : EPD_CONTROLLER_WIDTH;
      for (uint8_t row = 0; row < DCA_GRID_ROWS; ++row) {
        const uint16_t y0 =
            DCA_GRID_Y0 + row * (DCA_CELL_HEIGHT + DCA_ROW_GAP);
        for (uint8_t column = 0; column < DCA_GRID_COLUMNS; ++column) {
          const uint16_t x0 =
              halfOffset + DCA_GRID_X0_LOCAL +
              column * (DCA_CELL_WIDTH + DCA_COLUMN_GAP);
          dcaFillPatch(frame, x0, y0, row, column);
        }
      }
    }
  }

  std::memset(histogram, 0, DCA_CODE_COUNT * sizeof(uint32_t));
  for (size_t index = 0; index < EPD_FRAME_BYTES; ++index) {
    const uint8_t high = frame[index] >> 4;
    const uint8_t low = frame[index] & 0x0F;
    if (!dcaCodeLegal(high) || !dcaCodeLegal(low)) return false;
    ++histogram[high];
    ++histogram[low];
  }
  return true;
}

bool dcaDigestMatchesHex(const uint8_t digest[32], const char *expected) {
  if (!digest || !expected || std::strlen(expected) != 64) return false;
  static constexpr char kHex[] = "0123456789abcdef";
  for (size_t index = 0; index < 32; ++index) {
    if (expected[index * 2] != kHex[digest[index] >> 4] ||
        expected[index * 2 + 1] != kHex[digest[index] & 0x0F]) {
      return false;
    }
  }
  return true;
}

bool dcaComputeDtmIdentity(const uint8_t *frame, bool secondController,
                           DcaDtmIdentity *identity, int32_t *errorCode) {
  if (!frame || !identity || !errorCode) return false;
  *identity = DcaDtmIdentity{};
  *errorCode = 0;
  static constexpr size_t kFullRowBytes = EPD_WIDTH / 2;
  static constexpr size_t kControllerRowBytes = EPD_CONTROLLER_WIDTH / 2;
  uint8_t mappedRow[kControllerRowBytes] = {};
  const ControllerMapping &mapping =
      CONTROLLER_MAPPINGS[secondController ? 1 : 0];
  mbedtls_sha256_context context;
  mbedtls_sha256_init(&context);
  const int startsResult = mbedtls_sha256_starts_ret(&context, 0);
  if (startsResult != 0) {
    *errorCode = startsResult;
    mbedtls_sha256_free(&context);
    return false;
  }
  uint32_t dtmHash = FNV1A_OFFSET_BASIS;
  for (uint16_t outputY = 0; outputY < EPD_HEIGHT; ++outputY) {
    const uint16_t sourceY =
        mapping.flipY ? EPD_HEIGHT - 1 - outputY : outputY;
    const size_t rowOffset = static_cast<size_t>(sourceY) * kFullRowBytes;
    const size_t halfOffset =
        static_cast<size_t>(mapping.sourceHalf) * kControllerRowBytes;
    const uint8_t *row = frame + rowOffset + halfOffset;
    for (size_t outputByte = 0; outputByte < kControllerRowBytes;
         ++outputByte) {
      const size_t sourceByte = mapping.flipX
                                    ? kControllerRowBytes - 1 - outputByte
                                    : outputByte;
      uint8_t value = row[sourceByte];
      if (mapping.flipX != mapping.nibbleSwap) {
        value = static_cast<uint8_t>((value << 4) | (value >> 4));
      }
      mappedRow[outputByte] = value;
      dtmHash = fnv1aUpdate(dtmHash, value);
    }
    const int updateResult =
        mbedtls_sha256_update_ret(&context, mappedRow, sizeof(mappedRow));
    if (updateResult != 0) {
      *errorCode = updateResult;
      mbedtls_sha256_free(&context);
      return false;
    }
  }
  const int finishResult =
      mbedtls_sha256_finish_ret(&context, identity->sha256);
  mbedtls_sha256_free(&context);
  if (finishResult != 0) {
    *errorCode = finishResult;
    return false;
  }
  identity->fnv1a = dtmHash;
  return true;
}

bool dcaValidateRole(EpdDitherColorAtlasRole role, uint8_t *frame,
                     DcaValidation *validation) {
  if (!frame || !validation || !dcaRoleValid(role)) return false;
  *validation = DcaValidation{};
  if (!dcaValidateLayoutDesign()) {
    validation->failureStage = DCA_FAILURE_LAYOUT_DESIGN;
    return false;
  }
  uint32_t histogram[DCA_CODE_COUNT] = {};
  if (!dcaBuildFrame(role, frame, histogram)) {
    validation->failureStage = DCA_FAILURE_FRAME_BUILD;
    return false;
  }
  const DcaRoleIdentity &wanted = DCA_IDENTITIES[dcaRoleIndex(role)];
  if (std::memcmp(histogram, wanted.histogram, sizeof(wanted.histogram)) !=
      0) {
    validation->failureStage = DCA_FAILURE_HISTOGRAM;
    return false;
  }

  validation->frameFnv1a = fnv1a(frame, EPD_FRAME_BYTES);
  uint8_t frameDigest[32] = {};
  const int frameShaResult =
      mbedtls_sha256_ret(frame, EPD_FRAME_BYTES, frameDigest, 0);
  if (validation->frameFnv1a != wanted.frameFnv1a || frameShaResult != 0 ||
      !dcaDigestMatchesHex(frameDigest, wanted.frameSha256)) {
    validation->failureStage = DCA_FAILURE_FULL_SHA;
    validation->failureCode = frameShaResult;
    return false;
  }
  if (!dcaComputeDtmIdentity(frame, false, &validation->cs1,
                             &validation->failureCode)) {
    validation->failureStage = DCA_FAILURE_CS1_COMPUTE;
    return false;
  }
  if (!dcaComputeDtmIdentity(frame, true, &validation->cs2,
                             &validation->failureCode)) {
    validation->failureStage = DCA_FAILURE_CS2_COMPUTE;
    return false;
  }
  if (validation->cs1.fnv1a != wanted.cs1DtmFnv1a ||
      !dcaDigestMatchesHex(validation->cs1.sha256, wanted.cs1DtmSha256)) {
    validation->failureStage = DCA_FAILURE_CS1_IDENTITY;
    return false;
  }
  if (validation->cs2.fnv1a != wanted.cs2DtmFnv1a ||
      !dcaDigestMatchesHex(validation->cs2.sha256, wanted.cs2DtmSha256)) {
    validation->failureStage = DCA_FAILURE_CS2_IDENTITY;
    return false;
  }
  return true;
}

}  // namespace

bool epdValidateCompiledDitherColorAtlasFixtures() {
  if (!dcaValidateLayoutDesign()) return false;
  uint8_t *frame = static_cast<uint8_t *>(ps_malloc(EPD_FRAME_BYTES));
  if (!frame) return false;
  static constexpr EpdDitherColorAtlasRole kRoles[] = {
      EpdDitherColorAtlasRole::Atlas,
      EpdDitherColorAtlasRole::White,
  };
  bool valid = true;
  for (const EpdDitherColorAtlasRole role : kRoles) {
    DcaValidation validation;
    valid = dcaValidateRole(role, frame, &validation);
    if (!valid) break;
  }
  std::free(frame);
  return valid;
}

bool epdDisplayCompiledDitherColorAtlas(EpdDitherColorAtlasRole role) {
  // epdBeginOperation only initializes the diagnostic record. GPIO/SPI/panel
  // setup remains behind the complete allocation and identity gate below.
  const uint32_t started = epdBeginOperation(EPD_SPI_DEFAULT_HZ);
  diagnosticReport.freePsramBefore = ESP.getFreePsram();
  diagnosticReport.largestPsramBlockBefore =
      heap_caps_get_largest_free_block(MALLOC_CAP_SPIRAM);
  if (!dcaRoleValid(role)) {
    return epdRejectBeforePanelIo(started, DCA_FAILURE_FRAME_BUILD);
  }
  uint8_t *frame = static_cast<uint8_t *>(ps_malloc(EPD_FRAME_BYTES));
  if (!frame) {
    return epdRejectBeforePanelIo(started, DCA_FAILURE_ALLOCATION);
  }

  DcaValidation validation;
  const bool identityOk = dcaValidateRole(role, frame, &validation);
  diagnosticReport.inputFrameFnv1a = validation.frameFnv1a;
  diagnosticReport.cs1DtmFnv1a = validation.cs1.fnv1a;
  diagnosticReport.cs2DtmFnv1a = validation.cs2.fnv1a;
  if (!identityOk) {
    std::free(frame);
    return epdRejectBeforePanelIo(started, validation.failureStage,
                                  validation.failureCode);
  }

  // This is the unchanged, validated factory-OTP dual-controller cascade.
  // No LUT or waveform data is written by this fixture.
  if (!epdPrepareCascade(EPD_SPI_DEFAULT_HZ)) {
    std::free(frame);
    return epdFinishFailedOperationSafe(started,
                                        DCA_FAILURE_CASCADE_PREPARE);
  }
  const uint32_t cs1Started = millis();
  diagnosticReport.cs1DtmFnv1a =
      epdStreamPackedFrameController(frame, false);
  diagnosticReport.cs1UploadMs = millis() - cs1Started;
  const uint32_t cs2Started = millis();
  diagnosticReport.cs2DtmFnv1a =
      epdStreamPackedFrameController(frame, true);
  diagnosticReport.cs2UploadMs = millis() - cs2Started;
  diagnosticReport.mappingApplied = true;
  std::free(frame);

  const DcaRoleIdentity &wanted = DCA_IDENTITIES[dcaRoleIndex(role)];
  if (diagnosticReport.cs1DtmFnv1a != wanted.cs1DtmFnv1a ||
      diagnosticReport.cs2DtmFnv1a != wanted.cs2DtmFnv1a) {
    return epdFinishFailedOperationSafe(started,
                                        DCA_FAILURE_STREAM_IDENTITY);
  }
  setActiveControllers(true, true);
  const bool ok = epdSecondSettingAndRefresh();
  epdSetSpiFrequency(EPD_SPI_DEFAULT_HZ);
  if (!ok) epdRecordFailure(DCA_FAILURE_REFRESH_SEQUENCE);
  return epdFinishOperation(started, ok);
}
