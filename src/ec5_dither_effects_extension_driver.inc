// Included only by ec5_dither_effects_extension_epd_driver.cpp in the dedicated
// extension build. This fixture renders a fixed spatial mixture of already
// verified native factory-OTP colours. It exposes no raw
// frame, caller-selected colour, LUT, voltage, waveform, SPI-frequency,
// phase, timing, retry, recovery, or automatic chaining path.

static_assert(EPD_WIDTH == 1024 && EPD_HEIGHT == 600 &&
                  EPD_FRAME_BYTES == 307200 &&
                  EPD_CONTROLLER_WIDTH == 512 &&
                  EPD_CONTROLLER_FRAME_BYTES == 153600,
              "dither effects extension requires frozen 1024x600 packed 4bpp");
static_assert(EPD_CS1_SOURCE_HALF == 0 && !EPD_CS1_FLIP_X &&
                  !EPD_CS1_FLIP_Y && !EPD_CS1_NIBBLE_SWAP &&
                  EPD_CS2_SOURCE_HALF == 1 && !EPD_CS2_FLIP_X &&
                  !EPD_CS2_FLIP_Y && !EPD_CS2_NIBBLE_SWAP,
              "dither effects extension identities require MAP_ORIENT_V1");

namespace {

static constexpr uint8_t DEE_ROLE_COUNT = 3;
static constexpr uint8_t DEE_CODE_COUNT = 8;
static constexpr uint8_t DEE_CONTROLLER_COUNT = 2;
static constexpr uint8_t DEE_FAMILY_COUNT = 7;
static constexpr uint8_t DEE_BACKGROUND_CODE = 1;

static constexpr uint16_t DEE_GRADIENT_X0_LOCAL = 24;
static constexpr uint16_t DEE_GRADIENT_WIDTH = 464;
static constexpr uint16_t DEE_GRADIENT_Y0 = 14;
static constexpr uint16_t DEE_GRADIENT_ROW_HEIGHT = 72;
static constexpr uint16_t DEE_GRADIENT_ROW_GAP = 10;

static constexpr uint16_t DEE_CHART_X0_LOCAL = 24;
static constexpr uint16_t DEE_CHART_WIDTH = 464;
static constexpr uint16_t DEE_TRIFIELD_Y0 = 24;
static constexpr uint16_t DEE_TRIFIELD_HEIGHT = 224;
static constexpr uint16_t DEE_TRIFIELD_WIDTH = 224;
static constexpr uint16_t DEE_TRIFIELD_GAP = 16;
static constexpr uint16_t DEE_NEUTRAL_Y0 = 272;
static constexpr uint16_t DEE_NEUTRAL_HEIGHT = 112;
static constexpr uint16_t DEE_BLOCK_Y0 = 408;
static constexpr uint16_t DEE_BLOCK_HEIGHT = 112;
static constexpr uint16_t DEE_BLOCK_GAP = 4;
static constexpr uint16_t DEE_BLOCK_WIDTH = 74;
static constexpr uint16_t DEE_BLOCK_BORDER = 2;
static constexpr uint16_t DEE_DETAIL_Y0 = 536;
static constexpr uint16_t DEE_DETAIL_HEIGHT = 40;

static constexpr uint8_t DEE_FAMILY_CODES[DEE_FAMILY_COUNT][2] = {
    {3, 2}, {2, 1}, {6, 2}, {3, 5}, {3, 6}, {6, 5}, {3, 1},
};
static constexpr uint8_t DEE_LEGAL_CODES[6] = {0, 1, 2, 3, 5, 6};
static constexpr uint8_t DEE_BAYER_8X8[8][8] = {
    {0, 32, 8, 40, 2, 34, 10, 42},
    {48, 16, 56, 24, 50, 18, 58, 26},
    {12, 44, 4, 36, 14, 46, 6, 38},
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    {63, 31, 55, 23, 61, 29, 53, 21},
};

static_assert(DEE_GRADIENT_X0_LOCAL + DEE_GRADIENT_WIDTH <=
                  EPD_CONTROLLER_WIDTH &&
                  DEE_GRADIENT_Y0 +
                          DEE_FAMILY_COUNT * DEE_GRADIENT_ROW_HEIGHT +
                          (DEE_FAMILY_COUNT - 1) * DEE_GRADIENT_ROW_GAP <=
                      EPD_HEIGHT,
              "dither pair-gradient layout exceeds the panel");
static_assert(DEE_CHART_X0_LOCAL + DEE_CHART_WIDTH <= EPD_CONTROLLER_WIDTH &&
                  DEE_DETAIL_Y0 + DEE_DETAIL_HEIGHT <= EPD_HEIGHT,
              "dither effects chart exceeds the panel");
static_assert(DEE_BLOCK_WIDTH * 6 + DEE_BLOCK_GAP * 5 == DEE_CHART_WIDTH,
              "dither effects native blocks do not fill the chart");

// Exact identities independently regenerated by host/dither_effects_suite.py.
static constexpr char DEE_PAIR_GRADIENTS_FRAME_SHA256[] =
    "531306ff2f309ce8f85b76c851cbb90512b65f92c608ca5b0ae518920778f122";
static constexpr char DEE_PAIR_GRADIENTS_CS1_DTM_SHA256[] =
    "92ccf83245be714c5a8272882487f4e668edddf4a5cab8191bb5c609e8869404";
static constexpr char DEE_PAIR_GRADIENTS_CS2_DTM_SHA256[] =
    "92ccf83245be714c5a8272882487f4e668edddf4a5cab8191bb5c609e8869404";
static constexpr char DEE_EFFECTS_CHART_FRAME_SHA256[] =
    "02351166adb9d52e36eaccef0b50360c7c74806608ab404b5a08b648f5dc0865";
static constexpr char DEE_EFFECTS_CHART_CS1_DTM_SHA256[] =
    "b2a4159fd17ed409fe441773df0d8f657f503f53693d35a0a2720d6f6ec7f678";
static constexpr char DEE_EFFECTS_CHART_CS2_DTM_SHA256[] =
    "b2a4159fd17ed409fe441773df0d8f657f503f53693d35a0a2720d6f6ec7f678";
static constexpr char DEE_WHITE_FRAME_SHA256[] =
    "91f1ed45bf609a23fbdcfd037027c2e271484f58321a4707e889d11859d8453d";
static constexpr char DEE_WHITE_DTM_SHA256[] =
    "8b8fe04d4d48ab9d1abb4a858f68544164d1a091998664eef06869c098a78158";

static_assert(sizeof(DEE_PAIR_GRADIENTS_FRAME_SHA256) == 65 &&
                  sizeof(DEE_PAIR_GRADIENTS_CS1_DTM_SHA256) == 65 &&
                  sizeof(DEE_PAIR_GRADIENTS_CS2_DTM_SHA256) == 65 &&
                  sizeof(DEE_EFFECTS_CHART_FRAME_SHA256) == 65 &&
                  sizeof(DEE_EFFECTS_CHART_CS1_DTM_SHA256) == 65 &&
                  sizeof(DEE_EFFECTS_CHART_CS2_DTM_SHA256) == 65 &&
                  sizeof(DEE_WHITE_FRAME_SHA256) == 65 &&
                  sizeof(DEE_WHITE_DTM_SHA256) == 65,
              "dither effects extension SHA-256 identity length changed");

static constexpr const char *DEE_FAILURE_NONE = "none";
static constexpr const char *DEE_FAILURE_ALLOCATION = "allocation";
static constexpr const char *DEE_FAILURE_LAYOUT_DESIGN = "layout_design";
static constexpr const char *DEE_FAILURE_FRAME_BUILD = "frame_build";
static constexpr const char *DEE_FAILURE_HISTOGRAM = "histogram";
static constexpr const char *DEE_FAILURE_FULL_SHA = "full_sha";
static constexpr const char *DEE_FAILURE_CS1_COMPUTE = "cs1_compute";
static constexpr const char *DEE_FAILURE_CS2_COMPUTE = "cs2_compute";
static constexpr const char *DEE_FAILURE_CS1_IDENTITY = "cs1_identity";
static constexpr const char *DEE_FAILURE_CS2_IDENTITY = "cs2_identity";
static constexpr const char *DEE_FAILURE_CASCADE_PREPARE =
    "cascade_prepare";
static constexpr const char *DEE_FAILURE_STREAM_IDENTITY =
    "stream_identity";
static constexpr const char *DEE_FAILURE_REFRESH_SEQUENCE =
    "refresh_sequence";

struct DeeRoleIdentity {
  uint32_t frameFnv1a;
  uint32_t cs1DtmFnv1a;
  uint32_t cs2DtmFnv1a;
  const char *frameSha256;
  const char *cs1DtmSha256;
  const char *cs2DtmSha256;
  uint32_t histogram[DEE_CODE_COUNT];
};

static constexpr DeeRoleIdentity DEE_IDENTITIES[DEE_ROLE_COUNT] = {
    {0xA76BF65DUL,
     0xC06F0375UL,
     0xC06F0375UL,
     DEE_PAIR_GRADIENTS_FRAME_SHA256,
     DEE_PAIR_GRADIENTS_CS1_DTM_SHA256,
     DEE_PAIR_GRADIENTS_CS2_DTM_SHA256,
     {0, 213468, 100206, 133704, 0, 66780, 100242, 0}},
    {0x3E379CE5UL,
     0xBB30E82FUL,
     0xBB30E82FUL,
     DEE_EFFECTS_CHART_FRAME_SHA256,
     DEE_EFFECTS_CHART_CS1_DTM_SHA256,
     DEE_EFFECTS_CHART_CS2_DTM_SHA256,
     {94380, 359188, 40174, 40242, 0, 40242, 40174, 0}},
    {0x13340DC5UL,
     0xB7A855C5UL,
     0xB7A855C5UL,
     DEE_WHITE_FRAME_SHA256,
     DEE_WHITE_DTM_SHA256,
     DEE_WHITE_DTM_SHA256,
     {0, 614400, 0, 0, 0, 0, 0, 0}},
};

struct DeeDtmIdentity {
  uint32_t fnv1a = 0;
  uint8_t sha256[32] = {};
};

struct DeeValidation {
  const char *failureStage = DEE_FAILURE_NONE;
  int32_t failureCode = 0;
  uint32_t frameFnv1a = 0;
  DeeDtmIdentity cs1;
  DeeDtmIdentity cs2;
};

size_t deeRoleIndex(EpdDitherEffectsExtensionRole role) {
  return static_cast<size_t>(role);
}

bool deeRoleValid(EpdDitherEffectsExtensionRole role) {
  return deeRoleIndex(role) < DEE_ROLE_COUNT;
}

bool deeCodeLegal(uint8_t code) {
  return code == 0 || code == 1 || code == 2 || code == 3 || code == 5 ||
         code == 6;
}

bool deeValidateLayoutDesign() {
  bool ranks[64] = {};
  for (uint8_t y = 0; y < 8; ++y) {
    for (uint8_t x = 0; x < 8; ++x) {
      const uint8_t rank = DEE_BAYER_8X8[y][x];
      if (rank >= 64 || ranks[rank]) return false;
      ranks[rank] = true;
    }
  }
  for (uint8_t row = 0; row < DEE_FAMILY_COUNT; ++row) {
    const uint8_t codeA = DEE_FAMILY_CODES[row][0];
    const uint8_t codeB = DEE_FAMILY_CODES[row][1];
    if (!deeCodeLegal(codeA) || !deeCodeLegal(codeB) || codeA == codeB) {
      return false;
    }
  }
  return true;
}

void deeSetPixel(uint8_t *frame, uint16_t x, uint16_t y, uint8_t code) {
  const size_t offset = static_cast<size_t>(y) * (EPD_WIDTH / 2) + x / 2;
  if (x & 1U) {
    frame[offset] = static_cast<uint8_t>((frame[offset] & 0xF0U) | code);
  } else {
    frame[offset] =
        static_cast<uint8_t>((frame[offset] & 0x0FU) | (code << 4));
  }
}

uint8_t deeTwoCode(uint8_t codeA, uint8_t codeB, uint8_t aUnits,
                   uint16_t x, uint16_t y) {
  if (aUnits >= 64) return codeA;
  if (aUnits == 0) return codeB;
  return DEE_BAYER_8X8[y & 7U][x & 7U] < aUnits ? codeA : codeB;
}

uint8_t deeThreeCode(uint8_t codeA, uint8_t codeB, uint8_t codeC,
                     uint8_t unitsA, uint8_t unitsB, uint16_t x,
                     uint16_t y) {
  const uint8_t rank = DEE_BAYER_8X8[y & 7U][x & 7U];
  if (rank < unitsA) return codeA;
  if (rank < static_cast<uint8_t>(unitsA + unitsB)) return codeB;
  return codeC;
}

uint8_t deeRoundedUnits(uint32_t numerator, uint16_t denominator) {
  return static_cast<uint8_t>((numerator + denominator / 2U) / denominator);
}

void deeBuildPairGradients(uint8_t *frame) {
  for (uint8_t controller = 0; controller < DEE_CONTROLLER_COUNT;
       ++controller) {
    const uint16_t halfOffset =
        controller == 0 ? 0 : EPD_CONTROLLER_WIDTH;
    for (uint8_t row = 0; row < DEE_FAMILY_COUNT; ++row) {
      const uint16_t y0 =
          DEE_GRADIENT_Y0 +
          row * (DEE_GRADIENT_ROW_HEIGHT + DEE_GRADIENT_ROW_GAP);
      for (uint16_t localY = 0; localY < DEE_GRADIENT_ROW_HEIGHT;
           ++localY) {
        for (uint16_t localX = 0; localX < DEE_GRADIENT_WIDTH;
             ++localX) {
          const uint8_t aUnits = deeRoundedUnits(
              static_cast<uint32_t>(DEE_GRADIENT_WIDTH - 1 - localX) * 64U,
              DEE_GRADIENT_WIDTH - 1);
          const uint8_t code =
              deeTwoCode(DEE_FAMILY_CODES[row][0],
                         DEE_FAMILY_CODES[row][1], aUnits, localX, localY);
          deeSetPixel(frame, halfOffset + DEE_GRADIENT_X0_LOCAL + localX,
                      y0 + localY, code);
        }
      }
    }
  }
}

void deeFillTriField(uint8_t *frame, uint16_t halfOffset,
                     uint16_t x0Local, uint8_t codeA, uint8_t codeB) {
  for (uint16_t localY = 0; localY < DEE_TRIFIELD_HEIGHT; ++localY) {
    const uint8_t nonwhiteUnits = deeRoundedUnits(
        static_cast<uint32_t>(DEE_TRIFIELD_HEIGHT - 1 - localY) * 64U,
        DEE_TRIFIELD_HEIGHT - 1);
    for (uint16_t localX = 0; localX < DEE_TRIFIELD_WIDTH; ++localX) {
      const uint8_t unitsA = deeRoundedUnits(
          static_cast<uint32_t>(nonwhiteUnits) *
              (DEE_TRIFIELD_WIDTH - 1 - localX),
          DEE_TRIFIELD_WIDTH - 1);
      const uint8_t unitsB = nonwhiteUnits - unitsA;
      const uint8_t code =
          deeThreeCode(codeA, codeB, 1, unitsA, unitsB, localX, localY);
      deeSetPixel(frame, halfOffset + x0Local + localX,
                  DEE_TRIFIELD_Y0 + localY, code);
    }
  }
}

void deeBuildEffectsChart(uint8_t *frame) {
  for (uint8_t controller = 0; controller < DEE_CONTROLLER_COUNT;
       ++controller) {
    const uint16_t halfOffset =
        controller == 0 ? 0 : EPD_CONTROLLER_WIDTH;
    deeFillTriField(frame, halfOffset, DEE_CHART_X0_LOCAL, 3, 2);
    deeFillTriField(frame, halfOffset,
                    DEE_CHART_X0_LOCAL + DEE_TRIFIELD_WIDTH +
                        DEE_TRIFIELD_GAP,
                    5, 6);

    for (uint16_t localY = 0; localY < DEE_NEUTRAL_HEIGHT; ++localY) {
      for (uint16_t localX = 0; localX < DEE_CHART_WIDTH; ++localX) {
        const uint8_t blackUnits = deeRoundedUnits(
            static_cast<uint32_t>(DEE_CHART_WIDTH - 1 - localX) * 64U,
            DEE_CHART_WIDTH - 1);
        deeSetPixel(frame, halfOffset + DEE_CHART_X0_LOCAL + localX,
                    DEE_NEUTRAL_Y0 + localY,
                    deeTwoCode(0, 1, blackUnits, localX, localY));
      }
    }

    for (uint8_t index = 0; index < 6; ++index) {
      const uint16_t x0 =
          DEE_CHART_X0_LOCAL + index * (DEE_BLOCK_WIDTH + DEE_BLOCK_GAP);
      for (uint16_t y = DEE_BLOCK_Y0;
           y < DEE_BLOCK_Y0 + DEE_BLOCK_HEIGHT; ++y) {
        for (uint16_t x = x0; x < x0 + DEE_BLOCK_WIDTH; ++x) {
          const bool onBorder =
              x < x0 + DEE_BLOCK_BORDER ||
              x >= x0 + DEE_BLOCK_WIDTH - DEE_BLOCK_BORDER ||
              y < DEE_BLOCK_Y0 + DEE_BLOCK_BORDER ||
              y >= DEE_BLOCK_Y0 + DEE_BLOCK_HEIGHT - DEE_BLOCK_BORDER;
          deeSetPixel(frame, halfOffset + x, y,
                      onBorder ? 0 : DEE_LEGAL_CODES[index]);
        }
      }
    }

    const uint16_t zoneWidth = DEE_CHART_WIDTH / 4;
    static constexpr uint8_t featureWidths[4] = {1, 2, 4, 8};
    for (uint8_t zone = 0; zone < 4; ++zone) {
      const uint16_t x0 = DEE_CHART_X0_LOCAL + zone * zoneWidth;
      const uint16_t x1 =
          zone == 3 ? DEE_CHART_X0_LOCAL + DEE_CHART_WIDTH
                    : x0 + zoneWidth;
      const uint8_t featureWidth = featureWidths[zone];
      for (uint16_t localY = 0; localY < DEE_DETAIL_HEIGHT; ++localY) {
        for (uint16_t x = x0; x < x1; ++x) {
          const uint16_t localX = x - x0;
          const uint8_t code =
              (((localX / featureWidth) + (localY / featureWidth)) & 1U)
                  ? 0
                  : 1;
          deeSetPixel(frame, halfOffset + x, DEE_DETAIL_Y0 + localY, code);
        }
      }
    }
  }
}

bool deeBuildFrame(EpdDitherEffectsExtensionRole role, uint8_t *frame,
                   uint32_t *histogram) {
  if (!frame || !histogram || !deeRoleValid(role) ||
      !deeValidateLayoutDesign()) {
    return false;
  }
  std::memset(frame,
              static_cast<uint8_t>((DEE_BACKGROUND_CODE << 4) |
                                   DEE_BACKGROUND_CODE),
              EPD_FRAME_BYTES);
  if (role == EpdDitherEffectsExtensionRole::PairGradients) {
    deeBuildPairGradients(frame);
  } else if (role == EpdDitherEffectsExtensionRole::EffectsChart) {
    deeBuildEffectsChart(frame);
  }

  std::memset(histogram, 0, DEE_CODE_COUNT * sizeof(uint32_t));
  for (size_t index = 0; index < EPD_FRAME_BYTES; ++index) {
    const uint8_t high = frame[index] >> 4;
    const uint8_t low = frame[index] & 0x0F;
    if (!deeCodeLegal(high) || !deeCodeLegal(low)) return false;
    ++histogram[high];
    ++histogram[low];
  }
  return true;
}

bool deeDigestMatchesHex(const uint8_t digest[32], const char *expected) {
  if (!digest || !expected || std::strlen(expected) != 64) return false;
  static constexpr char kHex[] = "0123456789abcdef";
  for (size_t index = 0; index < 32; ++index) {
    if (expected[index * 2] != kHex[digest[index] >> 4] ||
        expected[index * 2 + 1] != kHex[digest[index] & 0x0F]) {
      return false;
    }
  }
  return true;
}

bool deeComputeDtmIdentity(const uint8_t *frame, bool secondController,
                           DeeDtmIdentity *identity, int32_t *errorCode) {
  if (!frame || !identity || !errorCode) return false;
  *identity = DeeDtmIdentity{};
  *errorCode = 0;
  static constexpr size_t kFullRowBytes = EPD_WIDTH / 2;
  static constexpr size_t kControllerRowBytes = EPD_CONTROLLER_WIDTH / 2;
  uint8_t mappedRow[kControllerRowBytes] = {};
  const ControllerMapping &mapping =
      CONTROLLER_MAPPINGS[secondController ? 1 : 0];
  mbedtls_sha256_context context;
  mbedtls_sha256_init(&context);
  const int startsResult = mbedtls_sha256_starts_ret(&context, 0);
  if (startsResult != 0) {
    *errorCode = startsResult;
    mbedtls_sha256_free(&context);
    return false;
  }
  uint32_t dtmHash = FNV1A_OFFSET_BASIS;
  for (uint16_t outputY = 0; outputY < EPD_HEIGHT; ++outputY) {
    const uint16_t sourceY =
        mapping.flipY ? EPD_HEIGHT - 1 - outputY : outputY;
    const size_t rowOffset = static_cast<size_t>(sourceY) * kFullRowBytes;
    const size_t halfOffset =
        static_cast<size_t>(mapping.sourceHalf) * kControllerRowBytes;
    const uint8_t *row = frame + rowOffset + halfOffset;
    for (size_t outputByte = 0; outputByte < kControllerRowBytes;
         ++outputByte) {
      const size_t sourceByte = mapping.flipX
                                    ? kControllerRowBytes - 1 - outputByte
                                    : outputByte;
      uint8_t value = row[sourceByte];
      if (mapping.flipX != mapping.nibbleSwap) {
        value = static_cast<uint8_t>((value << 4) | (value >> 4));
      }
      mappedRow[outputByte] = value;
      dtmHash = fnv1aUpdate(dtmHash, value);
    }
    const int updateResult =
        mbedtls_sha256_update_ret(&context, mappedRow, sizeof(mappedRow));
    if (updateResult != 0) {
      *errorCode = updateResult;
      mbedtls_sha256_free(&context);
      return false;
    }
  }
  const int finishResult =
      mbedtls_sha256_finish_ret(&context, identity->sha256);
  mbedtls_sha256_free(&context);
  if (finishResult != 0) {
    *errorCode = finishResult;
    return false;
  }
  identity->fnv1a = dtmHash;
  return true;
}

bool deeValidateRole(EpdDitherEffectsExtensionRole role, uint8_t *frame,
                     DeeValidation *validation) {
  if (!frame || !validation || !deeRoleValid(role)) return false;
  *validation = DeeValidation{};
  if (!deeValidateLayoutDesign()) {
    validation->failureStage = DEE_FAILURE_LAYOUT_DESIGN;
    return false;
  }
  uint32_t histogram[DEE_CODE_COUNT] = {};
  if (!deeBuildFrame(role, frame, histogram)) {
    validation->failureStage = DEE_FAILURE_FRAME_BUILD;
    return false;
  }
  const DeeRoleIdentity &wanted = DEE_IDENTITIES[deeRoleIndex(role)];
  if (std::memcmp(histogram, wanted.histogram, sizeof(wanted.histogram)) !=
      0) {
    validation->failureStage = DEE_FAILURE_HISTOGRAM;
    return false;
  }

  validation->frameFnv1a = fnv1a(frame, EPD_FRAME_BYTES);
  uint8_t frameDigest[32] = {};
  const int frameShaResult =
      mbedtls_sha256_ret(frame, EPD_FRAME_BYTES, frameDigest, 0);
  if (validation->frameFnv1a != wanted.frameFnv1a || frameShaResult != 0 ||
      !deeDigestMatchesHex(frameDigest, wanted.frameSha256)) {
    validation->failureStage = DEE_FAILURE_FULL_SHA;
    validation->failureCode = frameShaResult;
    return false;
  }
  if (!deeComputeDtmIdentity(frame, false, &validation->cs1,
                             &validation->failureCode)) {
    validation->failureStage = DEE_FAILURE_CS1_COMPUTE;
    return false;
  }
  if (!deeComputeDtmIdentity(frame, true, &validation->cs2,
                             &validation->failureCode)) {
    validation->failureStage = DEE_FAILURE_CS2_COMPUTE;
    return false;
  }
  if (validation->cs1.fnv1a != wanted.cs1DtmFnv1a ||
      !deeDigestMatchesHex(validation->cs1.sha256, wanted.cs1DtmSha256)) {
    validation->failureStage = DEE_FAILURE_CS1_IDENTITY;
    return false;
  }
  if (validation->cs2.fnv1a != wanted.cs2DtmFnv1a ||
      !deeDigestMatchesHex(validation->cs2.sha256, wanted.cs2DtmSha256)) {
    validation->failureStage = DEE_FAILURE_CS2_IDENTITY;
    return false;
  }
  return true;
}

}  // namespace

bool epdValidateCompiledDitherEffectsExtensionFixtures() {
  if (!deeValidateLayoutDesign()) return false;
  uint8_t *frame = static_cast<uint8_t *>(ps_malloc(EPD_FRAME_BYTES));
  if (!frame) return false;
  static constexpr EpdDitherEffectsExtensionRole kRoles[] = {
      EpdDitherEffectsExtensionRole::PairGradients,
      EpdDitherEffectsExtensionRole::EffectsChart,
      EpdDitherEffectsExtensionRole::White,
  };
  bool valid = true;
  for (const EpdDitherEffectsExtensionRole role : kRoles) {
    DeeValidation validation;
    valid = deeValidateRole(role, frame, &validation);
    if (!valid) break;
  }
  std::free(frame);
  return valid;
}

bool epdDisplayCompiledDitherEffectsExtension(EpdDitherEffectsExtensionRole role) {
  // epdBeginOperation only initializes the diagnostic record. GPIO/SPI/panel
  // setup remains behind the complete allocation and identity gate below.
  const uint32_t started = epdBeginOperation(EPD_SPI_DEFAULT_HZ);
  diagnosticReport.freePsramBefore = ESP.getFreePsram();
  diagnosticReport.largestPsramBlockBefore =
      heap_caps_get_largest_free_block(MALLOC_CAP_SPIRAM);
  if (!deeRoleValid(role)) {
    return epdRejectBeforePanelIo(started, DEE_FAILURE_FRAME_BUILD);
  }
  uint8_t *frame = static_cast<uint8_t *>(ps_malloc(EPD_FRAME_BYTES));
  if (!frame) {
    return epdRejectBeforePanelIo(started, DEE_FAILURE_ALLOCATION);
  }

  DeeValidation validation;
  const bool identityOk = deeValidateRole(role, frame, &validation);
  diagnosticReport.inputFrameFnv1a = validation.frameFnv1a;
  diagnosticReport.cs1DtmFnv1a = validation.cs1.fnv1a;
  diagnosticReport.cs2DtmFnv1a = validation.cs2.fnv1a;
  if (!identityOk) {
    std::free(frame);
    return epdRejectBeforePanelIo(started, validation.failureStage,
                                  validation.failureCode);
  }

  // This is the unchanged, validated factory-OTP dual-controller cascade.
  // No LUT or waveform data is written by this fixture.
  if (!epdPrepareCascade(EPD_SPI_DEFAULT_HZ)) {
    std::free(frame);
    return epdFinishFailedOperationSafe(started,
                                        DEE_FAILURE_CASCADE_PREPARE);
  }
  const uint32_t cs1Started = millis();
  diagnosticReport.cs1DtmFnv1a =
      epdStreamPackedFrameController(frame, false);
  diagnosticReport.cs1UploadMs = millis() - cs1Started;
  const uint32_t cs2Started = millis();
  diagnosticReport.cs2DtmFnv1a =
      epdStreamPackedFrameController(frame, true);
  diagnosticReport.cs2UploadMs = millis() - cs2Started;
  diagnosticReport.mappingApplied = true;
  std::free(frame);

  const DeeRoleIdentity &wanted = DEE_IDENTITIES[deeRoleIndex(role)];
  if (diagnosticReport.cs1DtmFnv1a != wanted.cs1DtmFnv1a ||
      diagnosticReport.cs2DtmFnv1a != wanted.cs2DtmFnv1a) {
    return epdFinishFailedOperationSafe(started,
                                        DEE_FAILURE_STREAM_IDENTITY);
  }
  setActiveControllers(true, true);
  const bool ok = epdSecondSettingAndRefresh();
  epdSetSpiFrequency(EPD_SPI_DEFAULT_HZ);
  if (!ok) epdRecordFailure(DEE_FAILURE_REFRESH_SEQUENCE);
  return epdFinishOperation(started, ok);
}


